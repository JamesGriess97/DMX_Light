#include "mcc_generated_files/i2c1.h"
#include "tm1650.h"
#include <stdint.h>

int count = 0;
static bool isOn = false;

const uint8_t charTable[] = 
{
    0x00, 0x82, 0x21, 0x00, 0x00, 0x00, 0x00, 0x02, 0x39, 0x0F, 0x00, 0x00, 0x00, 0x40, 0x80, 0x00,
    0x3F, 0x06, 0x5B, 0x4F, 0x66, 0x6D, 0x7D, 0x07, 0x7f, 0x6f, 0x00, 0x00, 0x00, 0x48, 0x00, 0x53,
    0x00, 0x77, 0x7C, 0x39, 0x5E, 0x79, 0x71, 0x6F, 0x76, 0x06, 0x1E, 0x00, 0x38, 0x00, 0x54, 0x3F,
    0x73, 0x67, 0x50, 0x6D, 0x78, 0x3E, 0x00, 0x00, 0x00, 0x6E, 0x00, 0x39, 0x00, 0x0F, 0x00, 0x08, 
    0x63, 0x5F, 0x7C, 0x58, 0x5E, 0x7B, 0x71, 0x6F, 0x74, 0x02, 0x1E, 0x00, 0x06, 0x00, 0x54, 0x5C,
    0x73, 0x67, 0x50, 0x6D, 0x78, 0x1C, 0x00, 0x00, 0x00, 0x6E, 0x00, 0x39, 0x30, 0x0F, 0x00, 0x00 
};

void writeData(uint8_t address, uint8_t data) {
    volatile I2C1_MESSAGE_STATUS status = I2C1_MESSAGE_PENDING;
    I2C1_MasterWrite(&data, 1, address, &status);
    while( status == I2C1_MESSAGE_PENDING ); // wait for transaction to complete
}

void TM1650_setDigit(uint8_t digit, char data, int dp) {
    writeData(0x34+digit, (charTable[data-32] | dp <<7));
}

void TM1650_init() {
    TM1650_enable(true);
}

/**
 * displays a number on the 7 seg display
 * @param num
 */
void TM1650_fastPrintNum(uint16_t num) {
    if(num > 9999) {
        TM1650_setDigit(0, 'E', 0);
        TM1650_setDigit(1, 'E', 0);
        TM1650_setDigit(2, 'E', 0);
        TM1650_setDigit(3, 'E', 0);
    } else {
        int i=0;
        for(i=0; i<4; i++) {
            int numWrite = num %10;
            TM1650_setDigit(3-i, numWrite+48, 0);
            num = num/10;
        }
    }
}

/**
 * turns on and off the display
 * @param enable
 */
void TM1650_enable(bool enable) {
    if(enable) {
        writeData(0x24, 1);
        isOn = true;
    } else {
        writeData(0x24, 0);
        isOn = false;
    }
}

/**
 * returns if the delay is on or off?
 * @return
 */
bool TM1650_isEnabled() {
    return isOn;
}
